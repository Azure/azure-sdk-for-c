## zephyr/Kconfig
```kconfig
config AZ
	bool "Azure SDK"

if AZ

config AZ_IOT_HUB
	bool "Azure IoT Hub Library"

config AZ_IOT_PROVISIONING
	bool "Azure IoT Provisioning Service Library"

endif # AZ
```
